## config/west.yml
```yaml
manifest:
  remotes:
    - name: zmkfirmware
      url-base: https://github.com/zmkfirmware
    - name: grigorynadolinsky
      url-base: https://github.com/GrigoryNadolinsky
  projects:
    - name: zmk
      remote: zmkfirmware
      revision: main
      import: app/west.yml
    - name: zmk-rgbled-widget
      remote: grigorynadolinsky
      revision: main
  self:
    path: config
```
